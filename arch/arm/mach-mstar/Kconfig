## arch/arm/mach-mstar/Kconfig
```kconfig
if ARCH_MSTARV7

choice
	prompt "MStar/SigmaStar board"
	default TARGET_SSC38M_V2
	help
	  Select the board to build U-Boot for. The board selects the SoC
	  family code and its default device tree.

config TARGET_SSC38M_V2
	bool "SSC_38M_2.0 IP camera module"
	select SUPPORT_OF_CONTROL
	select MACH_INFINITY6E
	help
	  Generic IP camera module based on the SigmaStar SSC338Q
	  (Infinity6E), PCB silkscreen "SSC_38M_2.0".

endchoice

config MACH_INFINITY6E
	bool

if DEBUG_UART

config DEBUG_UART_BASE
	default 0x1f221000

config DEBUG_UART_CLOCK
	default 172800000

config DEBUG_UART_SHIFT
	default 3

endif

config SYS_SOC
	default "mstar"

config SYS_VENDOR
	default "mstar"

config SYS_BOARD
	default "ssc38m-v2"

config SYS_CONFIG_NAME
	default "mstar"

endif
```

## configs/ssc38m_v2_defconfig
```kconfig
CONFIG_ARM=y
CONFIG_SKIP_LOWLEVEL_INIT=y
CONFIG_SYS_DCACHE_OFF=y
CONFIG_SYS_ARCH_TIMER=y
CONFIG_SYS_THUMB_BUILD=y
CONFIG_ARCH_MSTARV7=y
CONFIG_CMDLINE_TAG=y
CONFIG_INITRD_TAG=y
CONFIG_STATIC_MACH_TYPE=y
CONFIG_MACH_TYPE=1396
CONFIG_TEXT_BASE=0x23E00000
CONFIG_NR_DRAM_BANKS=1
CONFIG_DEFAULT_DEVICE_TREE="mstar-infinity6e-ssc338q-ssc38m-v2"
CONFIG_SYS_LOAD_ADDR=0x21000000
# CONFIG_EFI_LOADER is not set
CONFIG_BOOTDELAY=-1
CONFIG_HUSH_PARSER=y
CONFIG_SYS_PROMPT="SSC338Q # "
CONFIG_OF_CONTROL=y
CONFIG_DM_SERIAL=y
CONFIG_SYS_NS16550=y
CONFIG_SYSRESET=y
CONFIG_SYSRESET_SYSCON=y
CONFIG_LZMA=y
CONFIG_XZ=y
```
